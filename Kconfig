## Kconfig
```kconfig
DT_COMPAT_ZMK_BEHAVIOR_BASE_LAYER := zmk,behavior-base-layer

config ZMK_BEHAVIOR_BASE_LAYER
    bool
    default $(dt_compat_enabled,$(DT_COMPAT_ZMK_BEHAVIOR_BASE_LAYER))
```

## dts/bindings/behaviors/base-layer.yaml
```yaml
# Copyright (c) 2025 The ZMK Contributors
# SPDX-License-Identifier: MIT

description: Base Layer

compatible: "zmk,behavior-base-layer"

include: one_param.yaml
```
